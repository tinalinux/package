## dragontools/tinatest/Config.in
```kconfig
if PACKAGE_tinatest

config TINATEST_CUSTOM
    bool "Customize TinaTest options"
    default n
        help
          Enabling this allows full customization of tinatest settings.
          Note that these options will only customize your tinatest.json.
          You can write tinatest.json by yourself.
          See the documentation ./doc/README.txt & ./doc/CONFIG.txt

          Unless you know what you are doing, you should leave this as 'n'

if TINATEST_CUSTOM
    source "config/Config.in"
endif

endif
```

## dragontools/tinatest/config/Config.in
```kconfig
menu 'System Config'
    source sys/Config.in
endmenu

menu 'Demo For Testcases'
    source demo/Config.in
endmenu

menu 'Basical Functions'
    source base/Config.in
endmenu

menu 'Specifications'
    source spec/Config.in
endmenu

menu 'Stress'
    source stress/Config.in
endmenu
```

## dragontools/tinatest/config/base/Config.in
```kconfig
config TINATEST_BASE
    bool "Enable"

if TINATEST_BASE
    source Config-sdcard.in
    source Config-battery.in
endif
```

## dragontools/tinatest/config/demo/Config.in
```kconfig
config TINATEST_DEMO
    bool "Enable"
    default n

if TINATEST_DEMO
    source Config-demo-c.in
    source Config-demo-sh.in
endif
```

## dragontools/tinatest/config/stress/Config.in
```kconfig
config TINATEST_STRESS
    bool "Enable"

if TINATEST_STRESS
    source Config-reboot.in
    source Config-io.in
    source Config-ddr.in
    source Config-gpu.in
    source rw/Config.in
    source cpu/Config.in
    source Config-standby.in
endif
```

## dragontools/tinatest/config/stress/cpu/Config.in
```kconfig
menu 'cpu'
config TINATEST_STRESS_CPU
    bool "Enable"

if TINATEST_STRESS_CPU
    source Config-cpucalc.in
    source Config-cpufreq.in
    source Config-cpuhotplug.in
endif
endmenu
```

## dragontools/tinatest/config/stress/rw/Config.in
```kconfig
menu 'rw'
config TINATEST_STRESS_RW
    bool "Enable"

if TINATEST_STRESS_RW
    source Config-rw-auto.in
    source Config-rw-loop.in
endif
endmenu
```

## dragontools/tinatest/config/sys/Config.in
```kconfig
comment "Configs For TinaTest"
config TINATEST_SYS_GLOBAL
    bool "global"
    default y

if TINATEST_SYS_GLOBAL
    ####### info #######
    source Config-collectd.in
	source Config-outlog.in

    ####### limit #######
    config TINATEST_SYS_GLOBAL_LIMIT_RUN_CNT_UP_TO
        int "run_cnt_up_to"
        default 3
endif

comment "Configs For Testcases Default Setting"
config TINATEST_SYS_LOCAL
    bool "local"
    default y

if TINATEST_SYS_LOCAL
    ####### info #######
    config TINATEST_SYS_LOCAL_INFO_DATE
        bool "date"
        default y

    config TINATEST_SYS_LOCAL_INFO_RESOURCE
        bool "resource"
        default y

    ####### limit #######
    config TINATEST_SYS_LOCAL_LIMIT_RUN_TIMES
        int "run_times"
        default 1

    config TINATEST_SYS_LOCAL_LIMIT_RUN_ALONE
        bool "run_alone"
        default n

    config TINATEST_SYS_LOCAL_LIMIT_MAY_REBOOT
        bool "may_reboot"
        default n

    config TINATEST_SYS_LOCAL_LIMIT_RUN_PARALLEL
        bool "run_parallel"
        default n

    config TINATEST_SYS_LOCAL_LIMIT_RUN_TIME_SEC
        int "run_time_sec"
        default 10000

    config TINATEST_SYS_LOCAL_LIMIT_RUN_TIME_MIN
        int "run_times_min"
        default 0

    config TINATEST_SYS_LOCAL_LIMIT_RUN_TIME_HOUR
        int "run_times_hour"
        default 0
endif
```
